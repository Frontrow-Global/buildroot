## .defconfig
```kconfig
BR2_aarch64=y
BR2_cortex_a35=y
BR2_DL_DIR="$(BASE_DIR)/../../buildroot.dl"
BR2_PACKAGE_OVERRIDE_FILE="../buildroot_override"
BR2_GLOBAL_PATCH_DIR="$(BR2_EXTERNAL)/patches"
# BR2_PIC_PIE is not set
BR2_SSP_NONE=y
BR2_RELRO_NONE=y
BR2_FORTIFY_SOURCE_NONE=y
BR2_TOOLCHAIN_BUILDROOT_GLIBC=y
BR2_BINUTILS_VERSION_2_35_X=y
BR2_TOOLCHAIN_BUILDROOT_CXX=y
BR2_PACKAGE_HOST_GDB=y
BR2_TARGET_GENERIC_HOSTNAME="Frontrow"
BR2_TARGET_GENERIC_ISSUE="Welcome to Project Rosetta"
BR2_INIT_SYSTEMD=y
BR2_SYSTEM_BIN_SH_BASH=y
# BR2_TARGET_GENERIC_REMOUNT_ROOTFS_RW is not set
BR2_SYSTEM_DEFAULT_PATH="/bin:/sbin:/usr/bin:/usr/sbin"
BR2_ENABLE_LOCALE_WHITELIST="C en_US.UTF-8"
BR2_GENERATE_LOCALE="en_US.UTF-8"
BR2_ROOTFS_OVERLAY="$(BR2_EXTERNAL)/overlays"
BR2_ROOTFS_POST_BUILD_SCRIPT="$(BR2_EXTERNAL)/board/RK3308/post-build.sh"
BR2_ROOTFS_POST_IMAGE_SCRIPT="$(BR2_EXTERNAL)/board/RK3308/post-image.sh"
BR2_ROOTFS_POST_SCRIPT_ARGS="RK3308"
BR2_LINUX_KERNEL=y
BR2_LINUX_KERNEL_USE_CUSTOM_CONFIG=y
BR2_LINUX_KERNEL_CUSTOM_CONFIG_FILE="$(BR2_EXTERNAL)/board/RK3308/rk3308_linux_mainline_defconfig"
BR2_LINUX_KERNEL_DTS_SUPPORT=y
BR2_LINUX_KERNEL_CUSTOM_DTS_PATH="${BR2_EXTERNAL}/rockchip/rk3308b-firefly.dtsi ${BR2_EXTERNAL}/rockchip/rk3308b-rgb_7.0inch_CZNB070762T.dtsi ${BR2_EXTERNAL}/rockchip/rk3308b-roc-cc-plus-amic-rgb_7.0inch_emmc.dts ${BR2_EXTERNAL}/rockchip/rk3308b-roc-cc-plus.dtsi ${BR2_EXTERNAL}/rockchip/rk3308.dtsi ${BR2_EXTERNAL}/rockchip/rk3308k.dtsi ${BR2_EXTERNAL}/rockchip/rockchip-rk3308.h"
BR2_LINUX_KERNEL_DTB_OVERLAY_SUPPORT=y
BR2_PACKAGE_BUSYBOX_CONFIG_FRAGMENT_FILES="$(BR2_EXTERNAL)/board/RK3308/busybox.fragment"
BR2_PACKAGE_ALSA_UTILS=y
BR2_PACKAGE_ALSA_UTILS_ALSACONF=y
BR2_PACKAGE_ALSA_UTILS_ALSALOOP=y
BR2_PACKAGE_ALSA_UTILS_AMIXER=y
BR2_PACKAGE_ALSA_UTILS_APLAY=y
BR2_PACKAGE_ALSA_UTILS_SPEAKER_TEST=y
BR2_PACKAGE_FAAD2=y
BR2_PACKAGE_FFMPEG=y
BR2_PACKAGE_FFMPEG_GPL=y
BR2_PACKAGE_FFMPEG_NONFREE=y
BR2_PACKAGE_FFMPEG_FFPLAY=y
BR2_PACKAGE_FFMPEG_FFPROBE=y
BR2_PACKAGE_FFMPEG_AVRESAMPLE=y
BR2_PACKAGE_FFMPEG_POSTPROC=y
BR2_PACKAGE_FLAC=y
BR2_PACKAGE_JACK2=y
BR2_PACKAGE_LAME=y
BR2_PACKAGE_MPG123=y
BR2_PACKAGE_PULSEAUDIO=y
BR2_PACKAGE_PULSEAUDIO_DAEMON=y
BR2_PACKAGE_STRESS_NG=y
BR2_PACKAGE_E2FSPROGS=y
BR2_PACKAGE_LIBERATION=y
BR2_PACKAGE_WQY_ZENHEI=y
BR2_PACKAGE_HICOLOR_ICON_THEME=y
BR2_PACKAGE_LINUX_FIRMWARE=y
BR2_PACKAGE_LINUX_FIRMWARE_RTL_88XX_BT=y
BR2_PACKAGE_DBUS_GLIB=y
BR2_PACKAGE_PARTED=y
BR2_PACKAGE_USB_MODESWITCH_DATA=y
BR2_PACKAGE_PYTHON3=y
BR2_PACKAGE_LIBG7221=y
BR2_PACKAGE_LIBGSM=y
BR2_PACKAGE_LIBMAD=y
BR2_PACKAGE_LIBVORBIS=y
BR2_PACKAGE_SBC=y
BR2_PACKAGE_TAGLIB=y
BR2_PACKAGE_WEBRTC_AUDIO_PROCESSING=y
BR2_PACKAGE_LIBPNG=y
BR2_PACKAGE_LIBGPIOD=y
BR2_PACKAGE_LIBGPIOD_TOOLS=y
BR2_PACKAGE_LIBPCIACCESS=y
BR2_PACKAGE_LIBXKBCOMMON=y
BR2_PACKAGE_MTDEV=y
BR2_PACKAGE_JSON_C=y
BR2_PACKAGE_LIBOPENAPTX=y
BR2_PACKAGE_LIBCURL=y
BR2_PACKAGE_LIBCURL_CURL=y
BR2_PACKAGE_LIBMICROHTTPD=y
BR2_PACKAGE_LIBPJSIP=y
BR2_PACKAGE_ELL=y
BR2_PACKAGE_LIBBSD=y
BR2_PACKAGE_LIBEV=y
BR2_PACKAGE_LIBEVDEV=y
BR2_PACKAGE_LIBICAL=y
BR2_PACKAGE_LIBPTHREAD_STUBS=y
BR2_PACKAGE_LIBFRIBIDI=y
BR2_PACKAGE_NCURSES_WCHAR=y
BR2_PACKAGE_PCRE2=y
BR2_PACKAGE_PCRE2_16=y
BR2_PACKAGE_COLLECTD=y
BR2_PACKAGE_COLLECTD_CPU=y
BR2_PACKAGE_COLLECTD_DISK=y
BR2_PACKAGE_COLLECTD_INTERFACE=y
BR2_PACKAGE_COLLECTD_IPTABLES=y
BR2_PACKAGE_COLLECTD_LOAD=y
BR2_PACKAGE_COLLECTD_MEMORY=y
BR2_PACKAGE_COLLECTD_THERMAL=y
BR2_PACKAGE_COLLECTD_NETWORK=y
BR2_PACKAGE_SHARED_MIME_INFO=y
BR2_PACKAGE_XUTIL_UTIL_MACROS=y
BR2_PACKAGE_AVAHI=y
BR2_PACKAGE_AVAHI_DAEMON=y
BR2_PACKAGE_BLUEZ5_UTILS=y
# BR2_PACKAGE_BLUEZ5_UTILS_PLUGINS_NETWORK is not set
BR2_PACKAGE_CIVETWEB=y
BR2_PACKAGE_CIVETWEB_LIB=y
BR2_PACKAGE_IPTABLES_BPF_NFSYNPROXY=y
BR2_PACKAGE_IPTABLES_NFTABLES=y
BR2_PACKAGE_IPTRAF_NG=y
BR2_PACKAGE_IW=y
BR2_PACKAGE_NETWORK_MANAGER=y
BR2_PACKAGE_NETWORK_MANAGER_TUI=y
BR2_PACKAGE_OPENSSH=y
BR2_PACKAGE_RSYNC=y
BR2_PACKAGE_SHAIRPORT_SYNC=y
BR2_PACKAGE_TCPDUMP=y
BR2_PACKAGE_TMUX=y
BR2_PACKAGE_HTOP=y
BR2_PACKAGE_SEATD=y
BR2_PACKAGE_SYSTEMD_ANALYZE=y
BR2_PACKAGE_NANO=y
BR2_PACKAGE_UEMACS=y
BR2_PACKAGE_VIM=y
BR2_TARGET_ROOTFS_EXT2=y
BR2_TARGET_ROOTFS_EXT2_4=y
BR2_TARGET_ROOTFS_EXT2_SIZE="300M"
BR2_TARGET_UBOOT=y
BR2_TARGET_UBOOT_BUILD_SYSTEM_KCONFIG=y
BR2_TARGET_UBOOT_CUSTOM_GIT=y
BR2_TARGET_UBOOT_CUSTOM_REPO_URL="https://github.com/SmartCross/u-boot.git"
BR2_TARGET_UBOOT_CUSTOM_REPO_VERSION="09cb9f080aa6b34b4fda06df3683cc95760b917e"
BR2_TARGET_UBOOT_BOARD_DEFCONFIG="rk3308_firefly_uboot"
BR2_TARGET_UBOOT_NEEDS_DTC=y
BR2_TARGET_UBOOT_CUSTOM_DTS_PATH="${BR2_EXTERNAL}/board/RK3308/uboot_dts/*"
BR2_PACKAGE_HOST_DOSFSTOOLS=y
BR2_PACKAGE_HOST_EROFS_UTILS=y
BR2_PACKAGE_HOST_GENEXT2FS=y
BR2_PACKAGE_HOST_GENIMAGE=y
BR2_PACKAGE_HOST_MTOOLS=y
BR2_PACKAGE_HOST_PYTHON3=y
BR2_PACKAGE_HOST_RUSTC=y
BR2_PACKAGE_HOST_UBOOT_TOOLS=y
BR2_PACKAGE_RKBIN=y
BR2_PACKAGE_RKDEVICE=y
BR2_PACKAGE_STORAGE_INITIALIZER=y
BR2_PACKAGE_CM901_WEBSERVER=y
```
